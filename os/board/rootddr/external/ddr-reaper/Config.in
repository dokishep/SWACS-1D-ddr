## os/board/rootddr/external/ddr-reaper/Config.in
```kconfig
config BR2_PACKAGE_DDREAPER
    bool "ddr-reaper"
    help
      DDR Reaper watchdog daemon for RootDDR.
```

## os/board/rootddr/external/input-wizard/Config.in
```kconfig
config BR2_PACKAGE_INPUT_WIZARD
	bool "input-wizard"
	depends on BR2_PACKAGE_SDL3
	help
		Input mapping wizard for first boot configuration.
		SDL3-based wizard that prompts for button mapping
		and persists mapping to /var/data/input.conf.
```

## os/configs/rootddr_defconfig
```kconfig
#
# rootddr_defconfig — RootDDR x86_64 DDR Arcade OS
# Bead 8 scope: latency kernel fragment, ALSA low-latency, rt-tests, IRQ tuning.
# Bead 11 scope: X11 runtime, MAME, SDL, FFMPEG added separately.
#
BR2_x86_64=y
BR2_TOOLCHAIN_BUILDROOT_MUSL=y
BR2_TOOLCHAIN_BUILDROOT_CXX=y
BR2_KERNEL_HEADERS_6_6=y

# System / init
BR2_TARGET_GENERIC_GETTY_PORT="tty1"
BR2_SYSTEM_DHCP="eth0"
BR2_ROOTFS_DEVICE_CREATION_DYNAMIC_EUDEV=y
BR2_INIT_BUSYBOX=y

# Linux kernel with rootddr latency fragment
BR2_LINUX_KERNEL=y
BR2_LINUX_KERNEL_CUSTOM_VERSION=y
BR2_LINUX_KERNEL_CUSTOM_VERSION_VALUE="6.6.30"
BR2_LINUX_KERNEL_USE_ARCH_DEFAULT_CONFIG=y
BR2_LINUX_KERNEL_CONFIG_FRAGMENT_FILES="board/rootddr/kernel.fragment"

# X11 — fbdev / vesa only (graphics expansion in Bead 11)
BR2_PACKAGE_XORG7=y
BR2_PACKAGE_XSERVER_XORG_SERVER=y
BR2_PACKAGE_XSERVER_XORG_SERVER_MODULAR=y
BR2_PACKAGE_XDRIVER_XF86_INPUT_EVDEV=y
BR2_PACKAGE_XAPP_XINIT=y
BR2_PACKAGE_XAPP_XAUTH=y
BR2_PACKAGE_MCOOKIE=y
BR2_PACKAGE_XAPP_XMESSAGE=y
BR2_PACKAGE_XAPP_XRANDR=y
BR2_PACKAGE_XDRIVER_XF86_VIDEO_FBDEV=y
BR2_PACKAGE_XDRIVER_XF86_VIDEO_VESA=y

# Audio — ALSA + low-latency stubs
BR2_PACKAGE_ALSA_LIB=y
BR2_PACKAGE_ALSA_UTILS=y

# Real-time latency verification tools
BR2_PACKAGE_RT_TESTS=y

# Utility tools
BR2_PACKAGE_JQ=y
BR2_PACKAGE_ZSTD=y

# Bootloader — x86_64 UEFI
BR2_TARGET_GRUB2=y
BR2_TARGET_GRUB2_X86_64_EFI=y
BR2_TARGET_GRUB2_BUILTIN_MODULES_EFI="boot linux ext2 fat squash4 part_gpt normal efi_gop"

# RootFS overlay — S08realtime, ASL, USB gadget, input wizard, DT, d
BR2_ROOTFS_OVERLAY="board/rootddr/rootfs_overlay"

# Image generation
BR2_TARGET_ROOTFS_SQUASHFS=y
BR2_PACKAGE_HOST_GENIMAGE=y
BR2_PACKAGE_HOST_DOSFSTOOLS=y
BR2_PACKAGE_HOST_MTOOLS=y
BR2_ROOTFS_POST_IMAGE_SCRIPT="board/rootddr/post-image.sh support/scripts/genimage.sh"
BR2_ROOTFS_POST_SCRIPT_ARGS="-c board/rootddr/genimage.cfg"

# Build cache
BR2_CCACHE=y
```

## os/configs/swacs1d_defconfig
```kconfig
BR2_x86_64=y
BR2_TOOLCHAIN_BUILDROOT_MUSL=y
BR2_TOOLCHAIN_BUILDROOT_CXX=y
BR2_PACKAGE_HOST_RUSTC=y

# System
BR2_TARGET_GENERIC_GETTY_PORT="tty1"
BR2_SYSTEM_DHCP="eth0"
BR2_ROOTFS_DEVICE_CREATION_DYNAMIC_EUDEV=y
BR2_INIT_BUSYBOX=y

# Linux Kernel
BR2_LINUX_KERNEL=y
BR2_LINUX_KERNEL_CUSTOM_VERSION=y
BR2_LINUX_KERNEL_CUSTOM_VERSION_VALUE="6.6.30"
BR2_LINUX_KERNEL_USE_ARCH_DEFAULT_CONFIG=y
BR2_LINUX_KERNEL_NEEDS_HOST_OPENSSL=y
BR2_LINUX_KERNEL_NEEDS_HOST_LIBELF=y
BR2_LINUX_KERNEL_CONFIG_FRAGMENT_FILES="board/swacs1d/kernel.fragment"

# X11 & Graphics — VESA + fbdev only, no DRM/GBM/Mesa/KMS stack
BR2_PACKAGE_XORG7=y
BR2_PACKAGE_XSERVER_XORG_SERVER=y
BR2_PACKAGE_XSERVER_XORG_SERVER_MODULAR=y
BR2_PACKAGE_XDRIVER_XF86_INPUT_EVDEV=y
BR2_PACKAGE_XAPP_XINIT=y
BR2_PACKAGE_XAPP_XAUTH=y      # Required for startx
BR2_PACKAGE_MCOOKIE=y         # Required for startx (generates auth cookie)
BR2_PACKAGE_XAPP_XMESSAGE=y
BR2_PACKAGE_XAPP_XRANDR=y
BR2_PACKAGE_XAPP_XTERM=y      # For debugging
BR2_PACKAGE_XAPP_XCLOCK=n
BR2_PACKAGE_XDRIVER_XF86_VIDEO_FBDEV=y
BR2_PACKAGE_XDRIVER_XF86_VIDEO_VESA=y

# SDL3 — X11 only, no KMS/DRM
BR2_PACKAGE_SDL3=y
BR2_PACKAGE_SDL3_X11=y
BR2_PACKAGE_SDL3_IMAGE=y
BR2_PACKAGE_SDL3_TTF=y
BR2_PACKAGE_SDL3_MIXER=y

# Multimedia — ALSA audio only (no pulseaudio)
BR2_PACKAGE_ALSA_LIB=y
BR2_PACKAGE_ALSA_UTILS=y
BR2_PACKAGE_JQ=y

# Disk / partition tools
BR2_PACKAGE_GPTFDISK=y
BR2_PACKAGE_GPTFDISK_SGDISK=y
BR2_PACKAGE_UTIL_LINUX=y
BR2_PACKAGE_UTIL_LINUX_BLKID=y
BR2_PACKAGE_UTIL_LINUX_LSBLK=y

# exFAT support (kernel driver + FUSE fallback for initramfs)
BR2_PACKAGE_EXFAT_PROGS=y
BR2_PACKAGE_EXFAT_FUSE=y

# MAME — arcade emulator (Buildroot 2025.02 ships BR2_PACKAGE_MAME)
# When selecting MAME in menuconfig, ALSA_UTILS is auto-selected anyway;
# the line is left here explicitly for clarity.
BR2_PACKAGE_ALSA_UTILS=y
BR2_PACKAGE_MAME=y

# Compression / crypto
BR2_PACKAGE_OPENSSL=y
BR2_PACKAGE_ZSTD=y
BR2_PACKAGE_INITSCRIPTS=y

# Bootloader
BR2_TARGET_GRUB2=y
BR2_TARGET_GRUB2_X86_64_EFI=y
BR2_TARGET_GRUB2_BUILTIN_MODULES_EFI="boot linux ext2 fat squash4 part_gpt normal efi_gop"

# Image generation
BR2_TARGET_ROOTFS_SQUASHFS=y
BR2_PACKAGE_HOST_GENIMAGE=y
BR2_PACKAGE_HOST_DOSFSTOOLS=y
BR2_PACKAGE_HOST_MTOOLS=y
BR2_PACKAGE_HOST_GPTFDISK=y
BR2_ROOTFS_POST_IMAGE_SCRIPT="board/swacs1d/post-image.sh support/scripts/genimage.sh"
BR2_ROOTFS_POST_SCRIPT_ARGS="-c board/swacs1d/genimage.cfg"
BR2_ROOTFS_OVERLAY="board/swacs1d/rootfs_overlay"

# Build speed
BR2_CCACHE=y
```

## package/input-wizard/Config.in
```kconfig
config BR2_PACKAGE_INPUT_WIZARD
	bool "input-wizard"
	depends on BR2_PACKAGE_SDL3
	help
	  Input mapping wizard for first boot configuration.
	  Prompts user to map gamepad buttons and saves configuration.
```
